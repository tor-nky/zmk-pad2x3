## boards/shields/pad2x3/Kconfig.defconfig
```kconfig
# Copyright (c) 2024 Satoru NAKAYA
# SPDX-License-Identifier: MIT

if SHIELD_TEST

config ZMK_KEYBOARD_NAME
    default "pad2x3"

endif
```

## boards/shields/pad2x3/Kconfig.shield
```kconfig
# Copyright (c) 2024 Satoru NAKAYA
# SPDX-License-Identifier: MIT

config SHIELD_PAD2X3
    def_bool $(shields_list_contains,pad2x3)
```
